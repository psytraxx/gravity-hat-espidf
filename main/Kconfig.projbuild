## main/Kconfig.projbuild
```kconfig
menu "Gravity hat"

config HAT_LED_GPIO
    int "LED data GPIO"
    default 13
    help
        Data line of the WS2812B strip, through a 330 ohm series
        resistor. GPIO 13 is not a strapping pin, and sits next to GND
        and near 5V on the board's header.

config HAT_FRAME_MS
    int "Physics step period (ms)"
    default 18
    range 5 100
    help
        One physics step per period. The physics constants are per step,
        so a longer period slows the fluid down. The strip needs about
        15 ms per frame, and a fluid step about as long; the status log
        shows both. Raise the period if the physics runs over it.

config HAT_CALIBRATION
    bool "Calibration picture instead of the fluid"
    default n
    help
        For setting up the strip's geometry and the IMU: show a
        calibration picture instead of the fluid. Four coloured lines
        run up the hat, one LED per turn each: red at LED 0's angle,
        then green, blue and yellow a quarter turn apart. They
        stand straight if the LEDs per turn in main/core/config.h are
        right, and run red, green, blue, yellow counter-clockwise seen
        from above if the winding direction is. Tilt the hat and a white
        band lights the low side, where the fluid would run: if it lights
        the wrong side, set the IMU rotation (below).

config HAT_TAP_THRESHOLD_MG
    int "Tap threshold (mg)"
    default 1000
    range 300 4000
    help
        Jump in acceleration between two samples (4 ms apart) that counts
        as a tap. Raise it if sloshing the fluid changes its colour, lower
        it if double taps are missed.

config HAT_IMU_SPI_MOSI
    int "SPI MOSI GPIO (board SDA/SDI)"
    default 23

config HAT_IMU_SPI_MISO
    int "SPI MISO GPIO (board AD0/SDO)"
    default 19

config HAT_IMU_SPI_SCLK
    int "SPI SCLK GPIO (board SCL)"
    default 18

config HAT_IMU_SPI_CS
    int "SPI CS GPIO (board NCS)"
    default 5

config HAT_IMU_YAW_DEG
    int "IMU rotation (degrees)"
    default 90
    range 0 359
    help
        Where LED 0's side of the hat lies as the IMU board sees it: in
        degrees counter-clockwise (seen from above) from the board's X
        arrow. The firmware turns every reading back by as much. To find
        it, turn on the calibration picture with this at 0 and tip the
        hat so that LED 0's side (the red line) is lowest. The white band
        then lights the side the setting points at: on the green line it
        is 90, on the blue 180, on the yellow 270. The monitor logs it
        exactly as "low side at N deg" (add 360 if N is negative).

config HAT_IMU_I2C_SCAN
    bool "Scan for I2C devices on the IMU pins at startup"
    default n
    help
        Wiring check: before setting up SPI, hold NCS high (which puts the
        MPU-6500 on I2C) and probe every address with SCL on the SCLK pin
        and SDA on the MOSI pin. An MPU-6500 answers at 0x68 (AD0 low) or
        0x69 (AD0 high). The SPI setup turns the chip's I2C interface off
        until it is power cycled, so the scan only finds it after a power
        on, not after a reset.

menu "Microphone"

config HAT_MIC
    bool "Pulse the brightness with the sound"
    default y
    help
        Read an I2S microphone (INMP441 or alike) and pulse the fluid's
        brightness with the sound: dim in the quiet, full on a loud
        sound, fading after it. The firmware follows both the quiet and
        the loud parts, so beats pulse in a quiet room and over loud
        music alike. Without a microphone sending, the fluid stays at
        full brightness.

config HAT_MIC_SD
    int "Microphone SD (data) GPIO"
    depends on HAT_MIC
    default 32

config HAT_MIC_SCK
    int "Microphone SCK (bit clock) GPIO"
    depends on HAT_MIC
    default 33

config HAT_MIC_WS
    int "Microphone WS (word select) GPIO"
    depends on HAT_MIC
    default 25

config HAT_MIC_MIN_BRIGHTNESS
    int "Brightness in the quiet (%)"
    depends on HAT_MIC
    default 25
    range 0 100
    help
        The fluid's brightness while it is quiet, as a share of full.
        Loud sounds pulse it up to full.

endmenu

menu "Wi-Fi and firmware updates"

config HAT_WIFI_SSID
    string "Wi-Fi SSID"
    default ""
    help
        Network to join for firmware updates over Wi-Fi. Empty turns Wi-Fi
        off, and with it updates over Wi-Fi.

config HAT_WIFI_PASSWORD
    string "Wi-Fi password"
    default ""
    help
        Empty for an open network.

config HAT_HOSTNAME
    string "Hostname"
    default "hat"
    help
        DHCP and mDNS name: the hat answers at http://<hostname>.local/.

config HAT_OTA_TOKEN
    string "Update token"
    default ""
    help
        If set, an update must carry the header
        "Authorization: Bearer <token>". Empty lets anyone on the network
        update the hat.

endmenu

endmenu
```

## sdkconfig.defaults
```kconfig
CONFIG_IDF_TARGET="esp32"
CONFIG_ESPTOOLPY_FLASHSIZE_4MB=y
CONFIG_ESP_DEFAULT_CPU_FREQ_MHZ_240=y
CONFIG_COMPILER_OPTIMIZATION_SIZE=y
CONFIG_ESP_MAIN_TASK_STACK_SIZE=8192
CONFIG_FREERTOS_HZ=1000
CONFIG_PARTITION_TABLE_CUSTOM=y
CONFIG_PARTITION_TABLE_CUSTOM_FILENAME="partitions.csv"
CONFIG_BOOTLOADER_APP_ROLLBACK_ENABLE=y
CONFIG_ESP_WIFI_TASK_PINNED_TO_CORE_1=y
CONFIG_LWIP_TCPIP_TASK_AFFINITY_CPU1=y
CONFIG_MDNS_TASK_AFFINITY_CPU1=y
```
